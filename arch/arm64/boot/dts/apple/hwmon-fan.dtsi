// SPDX-License-Identifier: GPL-2.0-or-later OR MIT
/*
 * hwmon fan keys for Apple Silicon desktops/laptops with a single fan.
 *
 *  Copyright The Asahi Linux Contributors
 */

&smc {
	hwmon {
		fan {
			fan-F0Ac {
				apple,key-id = "F0Ac";
				label = "Fan";
				apple,fan-minimum = "F0Mn";
				apple,fan-maximum = "F0Mx";
				apple,fan-target = "F0Tg";
				apple,fan-mode = "F0Md";
			};
		};
	};
};
