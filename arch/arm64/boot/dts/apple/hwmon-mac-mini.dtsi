// SPDX-License-Identifier: GPL-2.0-or-later OR MIT
/*
 * hwmon sensors expected on all Mac mini models
 *
 * Copyright The Asahi Linux Contributors
 */

#include "hwmon-fan.dtsi"

&smc {
	hwmon {
		temperature {
			temperature-TW0P {
				apple,key-id = "TW0P";
				label = "WiFi/BT Module Temperature";
			};
		};
	};
};
