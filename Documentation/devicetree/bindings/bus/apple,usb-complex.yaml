## Documentation/devicetree/bindings/bus/apple,usb-complex.yaml
```yaml
%YAML 1.2
---
$id: http://devicetree.org/schemas/bus/apple,usb-complex.yaml#
$schema: http://devicetree.org/meta-schemas/core.yaml#

title: Apple USB Complex

maintainers:
  - Nick Chan <towinchenmi@gmail.com>

description: |
  Apple USB Complex is a power-mangaged bus that includes remap registers
  that allows using USB hardware blocks with 32-bit DMA, even without
  a real IOMMU. For a device connected to the complex to be used, the
  PM domain associated with the bus must first be turned on, and the
  remap registers be configured.

  The bindings for Apple USB Complex extend the bindings for "simple-pm-bus".

allOf:
  - $ref: simple-pm-bus.yaml#

# We need a select here so we don't match all nodes with 'simple-pm-bus'.
select:
  properties:
    compatible:
      contains:
        enum:
          - apple,s5l8960x-usb-complex
          - apple,t8011-usb-complex
          - apple,t8015-usb-complex
  required:
    - compatible

properties:
  compatible:
    oneOf:
      - items:
          - enum:
              - apple,t7000-usb-complex
              - apple,s8000-usb-complex
              - apple,t8010-usb-complex
          - const: apple,s5l8960x-usb-complex
          - const: simple-pm-bus
      - items:
          - enum:
              - apple,s5l8960x-usb-complex
              - apple,t8011-usb-complex
              - apple,t8015-usb-complex
          - const: simple-pm-bus

  reg:
    description: |
      Register ranges for the USB Complex. Some hardware has a USB2 PHY
      in the middle that are handled by another driver and thus need
      two ranges to avoid conflicts.
    minItems: 1
    maxItems: 2

  dma-ranges:
    description: |
      A single range for the memory region to be remapped. It must be a
      4 GiB range with DMA addresses starting at 0 and are typically
      mapped to the start of DRAM.
    maxItems: 1

  nonposted-mmio: true

patternProperties:
  "^.*@[0-9a-f]+$":
    description: Hardware attached to the bus
    type: object

    required:
      - reg

required:
  - compatible
  - reg
  - dma-ranges

unevaluatedProperties: false

examples:
  - |
    soc {
      #address-cells = <2>;
      #size-cells = <2>;

      bus@20c000000 {
        compatible = "apple,t8011-usb-complex", "simple-pm-bus";
        #address-cells = <2>;
        #size-cells = <2>;
        dma-ranges = <0x0 0x00000000 0x8 0x00000000 0x1 0x00000000>;
        nonposted-mmio;
        ranges;

        reg = <0x2 0x0c000000 0x0 0x40>,
              <0x2 0x0c000060 0x0 0x40>;
        power-domains = <&ps_usb>;
      };
    };

  - |
    soc {
      #address-cells = <2>;
      #size-cells = <2>;

      bus@21c000000 {
        compatible = "apple,t7000-usb-complex", "apple,s5l8960x-usb-complex", "simple-pm-bus";
        #address-cells = <2>;
        #size-cells = <2>;
        dma-ranges = <0x0 0x00000000 0x8 0x00000000 0x1 0x00000000>;
        nonposted-mmio;
        ranges;

        reg = <0x2 0x1c900000 0x0 0x100>;
        power-domains = <&ps_usb>;
      };
    };
```

## Documentation/devicetree/bindings/leds/backlight/apple,pmic-bl.yaml
```yaml
# SPDX-License-Identifier: (GPL-2.0 OR BSD-2-Clause)
%YAML 1.2
---
$id: http://devicetree.org/schemas/leds/backlight/apple,pmic-bl.yaml#
$schema: http://devicetree.org/meta-schemas/core.yaml#

title: Apple PMIC backlight

maintainers:
  - Nick Chan <towinchenmi@gmail.com>

description:
  This module is part of Apple PMICs. For more details see
  ../mfd/apple,pmic.yaml.

  A backlight WLED interface in Apple PMICs. There are two variants
  differing in how the backlight value is encoded in the registers.

allOf:
  - $ref: common.yaml#

properties:
  compatible:
    oneOf:
      - items:
          - const: apple,arabela-pmic-bl
          - const: apple,anya-pmic-bl
      - items:
          - const: apple,august-pmic-bl
          - const: apple,aria-pmic-bl
      - const: apple,anya-pmic-bl
      - const: apple,aria-pmic-bl

  reg:
    maxItems: 1

required:
  - compatible
  - reg

additionalProperties: false
```

## Documentation/devicetree/bindings/mfd/apple,pmic.yaml
```yaml
---
$id: http://devicetree.org/schemas/mfd/apple,pmic.yaml#
$schema: http://devicetree.org/meta-schemas/core.yaml#

title: Apple PMICs

maintainers:
  - Nick Chan <towinchenmi@gmail.com>

description: |
  Apple SoCs came with PMICs designed by Dialog Semiconductor before
  Apple switched to their own PMIC designs. However, the parts used
  by Apple appears to be sigificantly different from public parts
  offered by dialog.

  On A7 - A10X SoCs, they are attached over I2C. On A11 and T2 the
  PMIC is attached via SPMI.

  This binding describes simple MFD - I2C/SPMI device with 16-bit
  register address and 8-bit values that allows subdevices like RTC,
  power-off control, backlight and nvmem to be described.

  See also bindings/nvmem/apple,spmi-nvmem.yaml for a simpler
  binding with only nvmem functions exposed used for newer PMICs.

properties:
  compatible:
    oneOf:
      - items:
          - enum:
              - apple,adelyn-pmic
              - apple,adi-pmic
              - apple,amber-pmic
              - apple,angel-pmic
              - apple,antigua-pmic
              - apple,anya-pmic
              - apple,arabela-pmic
              - apple,aria-pmic
              - apple,august-pmic
              - apple,autumn-pmic
          - const: apple,i2c-pmic
      - items:
          - enum:
              - apple,agnes-pmic
              - apple,calpe-pmic
          - const: apple,spmi-pmic

  reg:
    maxItems: 1

  "#address-cells":
    const: 1

  "#size-cells":
    const: 1

patternProperties:
  "^backlight(@[0-9a-f]+)?$":
    $ref: /schemas/leds/backlight/apple,pmic-bl.yaml

  "^rtc(@[0-9a-f]+)?$":
    $ref: /schemas/rtc/apple,pmic-rtc.yaml

  "^nvmem(@[0-9a-f]+)?$":
    $ref: /schemas/nvmem/apple,pmic-nvmem.yaml

required:
  - compatible
  - reg
  - "#address-cells"
  - "#size-cells"

additionalProperties: false

examples:
  - |
    i2c {
        #address-cells = <1>;
        #size-cells = <0>;

        pmic@3c {
            compatible = "apple,arabela-pmic", "apple,i2c-pmic";
            reg = <0x3c>;
            #address-cells = <1>;
            #size-cells = <1>;

            rtc@500 {
                compatible = "apple,arabela-pmic-rtc", "apple,amber-pmic-rtc";
                reg = <0x500 0x10>;
                nvmem-cells = <&rtc_offset_0>;
                nvmem-cell-names = "rtc_offset";
            };

            backlight@600 {
                compatible = "apple,arabela-pmic-bl", "apple,anya-pmic-bl";
                reg = <0x600 0x2>;
            };

            nvmem@4000 {
                compatible = "apple,pmic-nvmem";
                reg = <0x4000 0x28>;

                nvmem-layout {
                    compatible = "fixed-layout";
                    #address-cells = <1>;
                    #size-cells = <1>;

                    rtc_offset_0: rtc-offset@4 {
                        reg = <0x4 0x4>;
                    };
                };
            };
        };
    };

  - |

    #include <dt-bindings/spmi/spmi.h>

    spmi {
        #address-cells = <2>;
        #size-cells = <0>;

        pmic@f {
            compatible = "apple,agnes-pmic", "apple,spmi-pmic";
            reg = <0xf SPMI_USID>;
            #address-cells = <1>;
            #size-cells = <1>;

            rtc@1400 {
                compatible = "apple,agnes-pmic-rtc", "apple,antigua-pmic-rtc";
                reg = <0x1400 0x10>;
                nvmem-cells = <&rtc_offset_1>;
                nvmem-cell-names = "rtc_offset";
            };

            nvmem@6000 {
                compatible = "apple,pmic-nvmem";
                reg = <0x6000 0x300>;

                nvmem-layout {
                    compatible = "fixed-layout";
                    #address-cells = <1>;
                    #size-cells = <1>;

                    rtc_offset_1: rtc-offset@4 {
                        reg = <0x4 0x4>;
                    };
                };
            };
        };
    };
```

## Documentation/devicetree/bindings/nvmem/apple,pmic-nvmem.yaml
```yaml
# SPDX-License-Identifier: GPL-2.0-only OR BSD-2-Clause
%YAML 1.2
---
$id: http://devicetree.org/schemas/nvmem/apple,pmic-nvmem.yaml#
$schema: http://devicetree.org/meta-schemas/core.yaml#

title: Apple PMIC NVMEM

description: |
  This module is part of Apple PMICs. For more details see
  ../mfd/apple,pmic.yaml.

  NVMEM cells found in Apple PMICs are used to store information
  including RTC offset and boot failure count.

  See also bindings/nvmem/apple,spmi-nvmem.yaml which describes
  PMICs with only NVMEM functions exposed.

maintainers:
  - Nick Chan <towinchenmi@gmail.com>

allOf:
  - $ref: nvmem.yaml#

properties:
  compatible:
    const: apple,pmic-nvmem

  reg:
    maxItems: 1

required:
  - compatible
  - reg

unevaluatedProperties: false
...
```

## Documentation/devicetree/bindings/phy/apple,ausb-phy.yaml
```yaml
# SPDX-License-Identifier: (GPL-2.0-only OR BSD-2-Clause)
%YAML 1.2
---
$id: http://devicetree.org/schemas/phy/apple,ausb-phy.yaml#
$schema: http://devicetree.org/meta-schemas/core.yaml#

title: Apple AUSB PHY

maintainers:
  - Nick Chan <towinchenmi@gmail.com>

description:
  Apple AUSB PHY is the USB PHY used in Apple SoCs before the introduced
  of the Apple Type-C PHY (ATCPHY). It supports USB 2.0, and, on T8011,
  USB 3.0 operation. This binding describes USB 2.0 operation only as
  supported by the driver.

properties:
  compatible:
    items:
      - enum:
          - apple,s5l8960x-ausb-phy
          - apple,t7000-ausb-phy
          - apple,s8000-ausb-phy
          - apple,t8010-ausb-phy
          - apple,t8011-ausb-phy
          - apple,t8015-ausb-phy
      - const: apple,ausb-phy

  reg:
    maxItems: 1

  "#phy-cells":
    const: 1

  mode-switch:
    type: boolean
    description:
      The PHY handles muxing between USB 2.0 Host and Device modes.

  power-domains:
    minItems: 1
    maxItems: 1

  apple,cfg0-device:
    $ref: /schemas/types.yaml#/definitions/uint32
    description:
      Tunable 0 for device mode.

  apple,cfg1-device:
    $ref: /schemas/types.yaml#/definitions/uint32
    description:
      Tunable 1 for device mode.

  apple,cfg0-host:
    $ref: /schemas/types.yaml#/definitions/uint32
    description:
      Tunable 0 for host mode.

  apple,cfg1-host:
    $ref: /schemas/types.yaml#/definitions/uint32
    description:
      Tunable 1 for host mode.

required:
  - compatible
  - reg
  - "#phy-cells"
  # The binding also requires tunables and they are filled by loader

additionalProperties: false

examples:
  - |
    phy@20c000060 {
        compatible = "apple,t8015-ausb-phy", "apple,ausb-phy";
        reg = <0x2 0x0c000060 0x0 0x20>;
        #phy-cells = <1>;
        power-domains = <&ps_usbctlreg>;
        /* Tunables to be filled by loader */
    };
```

## Documentation/devicetree/bindings/rtc/apple,pmic-rtc.yaml
```yaml
# SPDX-License-Identifier: (GPL-2.0 OR BSD-2-Clause)
%YAML 1.2
---
$id: http://devicetree.org/schemas/rtc/apple,pmic-rtc.yaml#
$schema: http://devicetree.org/meta-schemas/core.yaml#

title: Apple PMIC RTC device

maintainers:
  - Nick Chan <towinchenmi@gmail.com>

description:
  This module is part of Apple PMICs. For more details
  see ../mfd/apple,pmic.yaml.

  An RTC device that is part of the PMIC. Additionally an
  offset stored in an nvmem cell is required to compute the
  current date and time.

properties:
  compatible:
    oneOf:
      - items:
          - enum:
              - apple,adi-pmic-rtc
              - apple,anya-pmic-rtc
              - apple,arabela-pmic-rtc
          - const: apple,amber-pmic-rtc
      - items:
          - enum:
              - apple,aria-pmic-rtc
              - apple,adelyn-pmic-rtc
              - apple,angel-pmic-rtc
              - apple,august-pmic-rtc
              - apple,agnes-pmic-rtc
              - apple,calpe-pmic-rtc # Counter also exposed via SMC
          - const: apple,antigua-pmic-rtc
      - const: apple,amber-pmic-rtc
      - const: apple,antigua-pmic-rtc

  reg:
    maxItems: 1

  interrupts:
    maxItems: 1

  nvmem-cells:
    items:
      - description:
          Upper 32 Bit of RTC offset in seconds.
          # TODO: another cell for ticks specified in 32768 (2^15) Hz
          # clock ticks

  nvmem-cell-names:
    items:
      - const: rtc_offset

  wakeup-source: true

required:
  - compatible
  - reg

additionalProperties: false
...
```

## Documentation/devicetree/bindings/soc/apple/apple,t8015-pmp-v1.yaml
```yaml
# SPDX-License-Identifier: (GPL-2.0-only OR BSD-2-Clause)
%YAML 1.2
---
$id: http://devicetree.org/schemas/soc/apple/apple,t8015-pmp-v1.yaml#
$schema: http://devicetree.org/meta-schemas/core.yaml#

title: Apple T8015 Power Management Processor

maintainers:
  - Nick Chan <towinchemi@gmail.com>

description:
  Apple Power Management Processor regulates power consumption on Apple
  SoCs. This bindings describes the variant found on T8015.

properties:
  compatible:
    enum:
      - apple,t8015-pmp-v1

  reg:
    items:
      - description: ARM Cortex-A7 area
      - description: CPU control area
      - description: SRAM area

  reg-names:
    items:
      - const: akf
      - const: control
      - const: sram

  firmware-name:
    maxItems: 1

  mboxes:
    maxItems: 1

  mbox-names:
    const: mbox

  power-domains:
    items:
      - description: PMP CPU power domain
      - description: PMP SRAM power domain

  power-domain-names:
    items:
      - const: pmp
      - const: sram

additionalProperties: false

required:
  - compatible
  - reg
  - reg-names
  - firmware-name
  - mboxes
  - power-domains
  - power-domain-names

examples:
  - |
    soc {
      #address-cells = <2>;
      #size-cells = <2>;

      pmp: pmp@232300000 {
        compatible = "apple,t8015-pmp-v1";
        reg = <0x2 0x32300000 0x0 0x8000>,
              <0x2 0x32400000 0x0 0x10000>,
              <0x2 0x32500000 0x0 0x20000>;
        reg-names = "akf", "control", "sram";
        mboxes = <&pmp_mbox>;
        mbox-names = "mbox";
        power-domains = <&ps_pmp>, <&ps_pms_sram>;
        power-domain-names = "pmp", "sram";
        firmware-name = "apple/pmp-t8015.bin";
      };
    };
```
