## Documentation/devicetree/bindings/pci/apple,t8010-pcie.yaml
```yaml
# SPDX-License-Identifier: (GPL-2.0-only OR BSD-2-Clause)
%YAML 1.2
---
$id: http://devicetree.org/schemas/pci/apple,t8010-pcie.yaml#
$schema: http://devicetree.org/meta-schemas/core.yaml#

title: Apple H9P/T8010 PCIe Host Controller

maintainers:

description:
  Apple A10/T8010 devices use an older H9P PCIe root complex for the
  internal storage path.  It exposes one ECAM window shared by up to four
  root ports, controller-specific PHY and port register windows, and a
  controller-local MSI block.

allOf:
  - $ref: /schemas/pci/pci-host-bridge.yaml#
  - $ref: /schemas/interrupt-controller/msi-controller.yaml#

properties:
  compatible:
    const: apple,t8010-pcie

  reg:
    minItems: 10
    maxItems: 10

  reg-names:
    items:
      - const: config
      - const: phy0
      - const: phy1
      - const: phy2
      - const: port0
      - const: port1
      - const: port2
      - const: port3
      - const: nvmmu0
      - const: pcieclk-postup

  interrupts:
    description:
      Four port state interrupts followed by 32 MSI interrupts and the
      optional NVMMU fault interrupt for the active storage port.
    minItems: 37
    maxItems: 37

  clocks:
    minItems: 3
    maxItems: 3

  clock-names:
    items:
      - const: core
      - const: aux
      - const: ref

  power-domains:
    minItems: 3
    maxItems: 3

  power-domain-names:
    items:
      - const: core
      - const: aux
      - const: ref

  reset-gpios:
    description:
      PERST# GPIOs indexed by PCIe root port.
    minItems: 1
    maxItems: 4

  clkreq-gpios:
    description:
      CLKREQ# GPIOs indexed by PCIe root port.
    minItems: 1
    maxItems: 4

  msi-controller: true

  msi-parent: true

  apple,msi-doorbell:
    $ref: /schemas/types.yaml#/definitions/uint32
    description:
      MSI doorbell address programmed into downstream endpoints.

  apple,enabled-ports:
    $ref: /schemas/types.yaml#/definitions/uint32
    description:
      Bitmask of root ports that should be powered and trained.
    minimum: 1
    maximum: 15

  apple,nvmmu-iova:
    $ref: /schemas/types.yaml#/definitions/uint32
    description:
      Base device-visible address for the reserved NVMMU/SART window.

  memory-region:
    description:
      Reserved physical window programmed into the H9P NVMMU/SART path.
    maxItems: 1

  interrupt-controller: true

  '#interrupt-cells':
    const: 1

required:
  - compatible
  - reg
  - reg-names
  - interrupts
  - clocks
  - clock-names
  - power-domains
  - power-domain-names
  - reset-gpios
  - clkreq-gpios
  - bus-range
  - ranges
  - msi-controller
  - msi-parent
  - apple,enabled-ports
  - apple,nvmmu-iova
  - memory-region
  - '#interrupt-cells'

unevaluatedProperties: false

examples:
  - |
    #include <dt-bindings/gpio/gpio.h>
    #include <dt-bindings/interrupt-controller/apple-aic.h>

    reserved-memory {
        #address-cells = <2>;
        #size-cells = <2>;
        ranges;

        pcie0_nvmmu_window: nvmmu-window@8bee00000 {
            reg = <0x8 0xbee00000 0x0 0x01200000>;
            no-map;
        };
    };

    soc {
        #address-cells = <2>;
        #size-cells = <2>;

        pcie0: pcie@610000000 {
            compatible = "apple,t8010-pcie";
            device_type = "pci";

            reg = <0x6 0x10000000 0x0 0x1000000>,
                  <0x6 0x00000000 0x0 0x8000>,
                  <0x6 0x00008000 0x0 0x4000>,
                  <0x6 0x0a000000 0x0 0x40000>,
                  <0x6 0x01000000 0x0 0x4000>,
                  <0x6 0x02000000 0x0 0x4000>,
                  <0x6 0x03000000 0x0 0x4000>,
                  <0x6 0x04000000 0x0 0x4000>,
                  <0x6 0x01004000 0x0 0x4000>,
                  <0x6 0x00010000 0x0 0x8000>;
            reg-names = "config", "phy0", "phy1", "phy2",
                        "port0", "port1", "port2", "port3",
                        "nvmmu0", "pcieclk-postup";

            interrupt-parent = <&aic>;
            interrupts = <AIC_IRQ 270 IRQ_TYPE_LEVEL_HIGH>,
                         <AIC_IRQ 273 IRQ_TYPE_LEVEL_HIGH>,
                         <AIC_IRQ 276 IRQ_TYPE_LEVEL_HIGH>,
                         <AIC_IRQ 279 IRQ_TYPE_LEVEL_HIGH>,
                         <AIC_IRQ 288 IRQ_TYPE_EDGE_RISING>,
                         <AIC_IRQ 289 IRQ_TYPE_EDGE_RISING>,
                         <AIC_IRQ 290 IRQ_TYPE_EDGE_RISING>,
                         <AIC_IRQ 291 IRQ_TYPE_EDGE_RISING>,
                         <AIC_IRQ 292 IRQ_TYPE_EDGE_RISING>,
                         <AIC_IRQ 293 IRQ_TYPE_EDGE_RISING>,
                         <AIC_IRQ 294 IRQ_TYPE_EDGE_RISING>,
                         <AIC_IRQ 295 IRQ_TYPE_EDGE_RISING>,
                         <AIC_IRQ 296 IRQ_TYPE_EDGE_RISING>,
                         <AIC_IRQ 297 IRQ_TYPE_EDGE_RISING>,
                         <AIC_IRQ 298 IRQ_TYPE_EDGE_RISING>,
                         <AIC_IRQ 299 IRQ_TYPE_EDGE_RISING>,
                         <AIC_IRQ 300 IRQ_TYPE_EDGE_RISING>,
                         <AIC_IRQ 301 IRQ_TYPE_EDGE_RISING>,
                         <AIC_IRQ 302 IRQ_TYPE_EDGE_RISING>,
                         <AIC_IRQ 303 IRQ_TYPE_EDGE_RISING>,
                         <AIC_IRQ 304 IRQ_TYPE_EDGE_RISING>,
                         <AIC_IRQ 305 IRQ_TYPE_EDGE_RISING>,
                         <AIC_IRQ 306 IRQ_TYPE_EDGE_RISING>,
                         <AIC_IRQ 307 IRQ_TYPE_EDGE_RISING>,
                         <AIC_IRQ 308 IRQ_TYPE_EDGE_RISING>,
                         <AIC_IRQ 309 IRQ_TYPE_EDGE_RISING>,
                         <AIC_IRQ 310 IRQ_TYPE_EDGE_RISING>,
                         <AIC_IRQ 311 IRQ_TYPE_EDGE_RISING>,
                         <AIC_IRQ 312 IRQ_TYPE_EDGE_RISING>,
                         <AIC_IRQ 313 IRQ_TYPE_EDGE_RISING>,
                         <AIC_IRQ 314 IRQ_TYPE_EDGE_RISING>,
                         <AIC_IRQ 315 IRQ_TYPE_EDGE_RISING>,
                         <AIC_IRQ 316 IRQ_TYPE_EDGE_RISING>,
                         <AIC_IRQ 317 IRQ_TYPE_EDGE_RISING>,
                         <AIC_IRQ 318 IRQ_TYPE_EDGE_RISING>,
                         <AIC_IRQ 319 IRQ_TYPE_EDGE_RISING>,
                         <AIC_IRQ 272 IRQ_TYPE_EDGE_RISING>;

            msi-controller;
            msi-parent = <&pcie0>;
            apple,msi-doorbell = <0xbffff000>;
            apple,enabled-ports = <0x1>;
            apple,nvmmu-iova = <0xbc000000>;
            memory-region = <&pcie0_nvmmu_window>;

            #address-cells = <3>;
            #size-cells = <2>;
            #interrupt-cells = <1>;
            bus-range = <0x00 0x0f>;
            ranges = <0x03000000 0x0 0xc0000000
                      0x7 0xc0000000 0x0 0x40000000>;

            clocks = <&clkref>, <&clkref>, <&clkref>;
            clock-names = "core", "aux", "ref";
            power-domains = <&ps_pcie>, <&ps_pcie_aux>,
                            <&ps_pcie_ref>;
            power-domain-names = "core", "aux", "ref";

            reset-gpios = <&pinctrl_ap 12 GPIO_ACTIVE_HIGH>;
            clkreq-gpios = <&pinctrl_ap 16 GPIO_ACTIVE_HIGH>;
        };
    };

...
```

## Documentation/devicetree/bindings/phy/apple,atcphy.yaml
```yaml
# SPDX-License-Identifier: (GPL-2.0-only OR BSD-2-Clause)
%YAML 1.2
---
$id: http://devicetree.org/schemas/phy/apple,atcphy.yaml#
$schema: http://devicetree.org/meta-schemas/core.yaml#

title: Apple Type-C PHY (ATCPHY)

maintainers:
  - Sven Peter <sven@svenpeter.dev>

description:
  The Apple Type-C PHY (ATCPHY) is a PHY for USB 2.0, USB 3.x,
  USB4/Thunderbolt, and DisplayPort connectivity found in Apple Silicon SoCs.

  The PHY handles muxing between these different protocols and also provides the
  reset controller for the attached dwc3 USB controller.

  The PHY is designed for USB4 operation and does not handle individual
  differential pairs as distinct DisplayPort lanes. Any reference to lane in
  this binding hence refers to two differential pairs (RX and TX) as used in USB
  terminology.

properties:
  compatible:
    enum:
      - apple,t6000-atcphy
      - apple,t6000-atcphy-dp-only # PHY hardwired to DP-to-HDMI converter on M2 Pro MacBook
      - apple,t6020-atcphy
      - apple,t8103-atcphy
      - apple,t8103-atcphy-capcode-workaround # M1 PHY with additional hardware quirk
      - apple,t8112-atcphy

  reg:
    minItems: 6
    maxItems: 6

  reg-names:
    items:
      - const: core
      - const: lpdptx
      - const: axi2af
      - const: usb2phy
      - const: pipehandler
      - const: usb4pmgr

  "#phy-cells":
    const: 1

  "#reset-cells":
    const: 0

  nvmem-cells:
    minItems: 9
    maxItems: 10
    description: |
      References to nvmem cells for PHY calibration values containing
      factory-programmed values.

      cio3pll_dll_start_capcode_workaround is optional and only required for
      one of the two PHYs preset on t8103 (M1). Starting with t6020 (M2 Pro)
      these calibration values are no longer required and presumably applied
      either directly in hardware or by iBoot before we get control.

  nvmem-cell-names:
    minItems: 9
    maxItems: 10
    items:
      - const: aus_cmn_shm_vreg_trim
      - const: auspll_rodco_encap
      - const: auspll_rodco_bias_adjust
      - const: auspll_fracn_dll_start_capcode
      - const: auspll_dtc_vreg_adjust
      - const: cio3pll_dco_coarsebin0
      - const: cio3pll_dco_coarsebin1
      - const: cio3pll_dll_start_capcode
      - const: cio3pll_dtc_vreg_adjust
      - const: cio3pll_dll_start_capcode_workaround

  orientation-switch:
    type: boolean
    description:
      The PHY handles swapping lanes if the Type-C connector is flipped.

  mode-switch:
    type: boolean
    description:
      The PHY handles muxing between USB 2.0, USB 3.x, USB4/Thunderbolt, and DisplayPort.

  power-domains:
    minItems: 1
    maxItems: 1

  port:
    $ref: /schemas/graph.yaml#/properties/port
    description:
      This port is used to connect the PHY to the Type-C port and represents
      the two SS RX/TX pairs.

  apple,tunable-axi2af:
    $ref: /schemas/types.yaml#/definitions/uint32-array
    description:
      AXI2AF tunables.

      This array is filled with 3-tuples each containing three 32-bit values
      <register offset>, <mask>, and <value> by the bootloader.
      The driver will use these to configure the PHY by reading from each
      register, ANDing it with <mask>, ORing it with <value>, and storing the
      result back to the register.
      These values slightly differ even between different chips of the same
      generation and are likely calibration values determined by Apple at
      manufacturing time.

  apple,tunable-common:
    $ref: /schemas/types.yaml#/definitions/uint32-array
    description:
      common tunables required for all modes, see apple,tunable-axi2af for details.

  apple,tunable-lane0-usb:
    $ref: /schemas/types.yaml#/definitions/uint32-array
    description:
      USB tunables on lane 0, see apple,tunable-axi2af for details.

  apple,tunable-lane1-usb:
    $ref: /schemas/types.yaml#/definitions/uint32-array
    description:
      USB tunables on lane 1, see apple,tunable-axi2af for details.

  apple,tunable-lane0-cio:
    $ref: /schemas/types.yaml#/definitions/uint32-array
    description:
      USB4/Thunderbolt ("converged IO") tunables on lane 0, see apple,tunable-axi2af for details.

  apple,tunable-lane1-cio:
    $ref: /schemas/types.yaml#/definitions/uint32-array
    description:
      USB4/Thunderbolt ("converged IO") tunables on lane 1, see apple,tunable-axi2af for details.

  apple,tunable-lane0-dp:
    $ref: /schemas/types.yaml#/definitions/uint32-array
    description:
      DisplayPort tunables on lane 0, see apple,tunable-axi2af for details.

      Note that lane here refers to a USB RX and TX pair re-used for DisplayPort
      and not to an individual DisplayPort differential lane.

  apple,tunable-lane1-dp:
    $ref: /schemas/types.yaml#/definitions/uint32-array
    description:
      DisplayPort tunables on lane 1, see apple,tunable-axi2af for details.

      Note that lane here refers to a USB RX and TX pair re-used for DisplayPort
      and not to an individual DisplayPort differential lane.

required:
  - compatible
  - reg
  - reg-names
  - "#phy-cells"
  - "#reset-cells"
  - orientation-switch
  - mode-switch

allOf:
  - if:
      properties:
        compatible:
          contains:
            enum:
              - apple,t6000-atcphy
              - apple,t6000-atcphy-dp-only
              - apple,t8103-atcphy
              - apple,t8112-atcphy
    then:
      properties:
        nvmem-cells:
          maxItems: 9
        nvmem-cell-names:
          maxItems: 9
  - if:
      properties:
        compatible:
          contains:
            enum:
              - apple,t8103-atcphy-capcode-workaround
    then:
      properties:
        nvmem-cells:
          minItems: 10
        nvmem-cell-names:
          minItems: 10
  - if:
      properties:
        compatible:
          contains:
            enum:
              - apple,t6020-atcphy
    then:
      properties:
        nvmem-cells: false
        nvmem-cell-names: false

additionalProperties: false

examples:
  - |
    phy@383000000 {
        compatible = "apple,t8103-atcphy";
        reg = <0x3 0x83000000 0x0 0x4c000>,
              <0x3 0x83050000 0x0 0x8000>,
              <0x3 0x80000000 0x0 0x4000>,
              <0x3 0x82a90000 0x0 0x4000>,
              <0x3 0x82a84000 0x0 0x4000>,
              <0x2 0x3b784000 0x0 0x4000>;
        reg-names = "core", "lpdptx", "axi2af", "usb2phy",
                    "pipehandler", "usb4pmgr";

        #phy-cells = <1>;
        #reset-cells = <0>;

        nvmem-cells = <&atcphy0_aus_cmn_shm_vreg_trim>,
                      <&atcphy0_auspll_rodco_encap>,
                      <&atcphy0_auspll_rodco_bias_adjust>,
                      <&atcphy0_auspll_fracn_dll_start_capcode>,
                      <&atcphy0_auspll_dtc_vreg_adjust>,
                      <&atcphy0_cio3pll_dco_coarsebin0>,
                      <&atcphy0_cio3pll_dco_coarsebin1>,
                      <&atcphy0_cio3pll_dll_start_capcode>,
                      <&atcphy0_cio3pll_dtc_vreg_adjust>;
        nvmem-cell-names = "aus_cmn_shm_vreg_trim",
                           "auspll_rodco_encap",
                           "auspll_rodco_bias_adjust",
                           "auspll_fracn_dll_start_capcode",
                           "auspll_dtc_vreg_adjust",
                           "cio3pll_dco_coarsebin0",
                           "cio3pll_dco_coarsebin1",
                           "cio3pll_dll_start_capcode",
                           "cio3pll_dtc_vreg_adjust";

        orientation-switch;
        mode-switch;
        power-domains = <&ps_atc0_usb>;
    };
  - |
    phy@383000000 {
        compatible = "apple,t6020-atcphy";
        reg = <0x3 0x83000000 0x0 0x4c000>,
              <0x3 0x83050000 0x0 0x8000>,
              <0x3 0x80000000 0x0 0x4000>,
              <0x3 0x82a90000 0x0 0x4000>,
              <0x3 0x82a84000 0x0 0x4000>,
              <0x2 0x3b784000 0x0 0x4000>;
        reg-names = "core", "lpdptx", "axi2af", "usb2phy",
                    "pipehandler", "usb4pmgr";

        #phy-cells = <1>;
        #reset-cells = <0>;

        orientation-switch;
        mode-switch;
        power-domains = <&ps_atc0_usb>;
    };
```
