## Documentation/devicetree/bindings/phy/apple,usbx-phy.yaml
```yaml
# SPDX-License-Identifier: GPL-2.0-only OR MIT
%YAML 1.2
---
$id: http://devicetree.org/schemas/phy/apple,usbx-phy.yaml#
$schema: http://devicetree.org/meta-schemas/core.yaml#

title: Apple USB Complex PHY

description:
  The Apple USB Complex is a PHY that is used in various lightning port
  iPhone, iPad and iPod touches. It is also used in some USB 2.0 only
  Type-C Apple devices like Apple TV HD and iBridge T2.

maintainers:
  - Nick Chan <towinchenmi@gmail.com>

properties:
  compatible:
    oneOf:
      - items:
          - enum:
              - apple,s5l8960x-usbx-phy
              - apple,t8011-usbx-phy
              - apple,t8015-usbx-phy
      - items:
          - enum:
              - apple,t7000-usbx-phy
              - apple,s8000-usbx-phy
              - apple,t8010-usbx-phy
          - const: apple,s5l8960x-usbx-phy

  reg:
    maxItems: 2

  reg-names:
    items:
      - const: core
      - const: otg

  power-domains:
    description: |
        Power domains for the PHY. Typically consists of two domains, one
        for the whole PHY and the other for some control registers.
    maxItems: 2

  mode-switch: true

  "#phy-cells":
    const: 0

  "#reset-cells":
    const: 0

required:
  - compatible
  - reg
  - reg-names
  - '#phy-cells'
  - '#reset-cells'

additionalProperties: false

examples:
  - |
    soc {
        #address-cells = <2>;
        #size-cells = <2>;

        phy@230000000 {
            compatible = "apple,t8015-usbx-phy";
            reg = <0x2 0x30000000 0x0 0x100>,
                  <0x2 0x30000060 0x0 0x20>;
            reg-names = "core", "otg";
            mode-switch;
            #phy-cells = <0>;
            #reset-cells = <0>;
        };
    };
```

## Documentation/devicetree/bindings/rtc/dlg,da2xxx-rtc.yaml
```yaml
# SPDX-License-Identifier: (GPL-2.0 OR BSD-2-Clause)
%YAML 1.2
---
$id: http://devicetree.org/schemas/rtc/dlg,da2xxx-rtc.yaml#
$schema: http://devicetree.org/meta-schemas/core.yaml#

title: Dialog DA2xxx PMIC RTC device

maintainers:
  - Nick Chan <towinchenmi@gmail.com>

description:
  This module is part of Dialog DA2xxx PMICs. For more details
  see ../mfd/dlg,da2xxx.yaml.

  An RTC device that consist of an immutable counter that could count a
  limited amount of time, coupled with an nvmem cell to store the rest of the
  time.

properties:
  compatible:
    oneOf:
      - items:
          - enum:
              - dlg,da2089-rtc
              - dlg,da2186-rtc
              - dlg,da2207-rtc
          - const: dlg,da2045-rtc
      - items:
          - enum:
              - dlg,da2257-rtc
              - dlg,da2333-rtc
              - dlg,da2365-rtc
              - dlg,da2400-rtc
              - dlg,da2422-rtc
              - dlg,da2449-rtc
          - const: dlg,da2255-rtc
      - const: dlg,da2045-rtc
      - const: dlg,da2255-rtc


  reg:
    maxItems: 1

  interrupts:
    maxItems: 1

  nvmem-cells:
    items:
      - description:
          four-byte nvmem cell holding a little-endian offset from the Unix
          epoch which represent most of the time that the immutable counter
          cannot represent.

  nvmem-cell-names:
    items:
      - const: rtc_offset

  wakeup-source: true

required:
  - compatible
  - reg

additionalProperties: false
...
```

## Documentation/devicetree/bindings/soc/apple/apple,t8015-pmp.yaml
```yaml
# SPDX-License-Identifier: (GPL-2.0-only OR BSD-2-Clause)
%YAML 1.2
---
$id: http://devicetree.org/schemas/soc/apple/apple,t8015-pmp.yaml#
$schema: http://devicetree.org/meta-schemas/core.yaml#

title: Apple T8015 Power Management Processor

maintainers:
  - Nick Chan <towinchemi@gmail.com>

description:
  Apple Power Management Processor regulates power consumption on Apple
  SoCs. This bindings describes the variant found on T8015.

properties:
  compatible:
    enum:
      - apple,t8015-pmp

  reg:
    items:
      - description: ARM Cortex-A7 area
      - description: CPU control area
      - description: SRAM area

  reg-names:
    items:
      - const: akf
      - const: control
      - const: sram

  firmware-name:
    maxItems: 1

  mboxes:
    maxItems: 1

  mbox-names:
    const: mbox

  power-domains:
    maxItems: 1
    description: PMP CPU power domain

additionalProperties: false

required:
  - compatible
  - reg
  - reg-names
  - firmware-name
  - mboxes

examples:
  - |
    soc {
      #address-cells = <2>;
      #size-cells = <2>;

      pmp: pmp@232300000 {
        compatible = "apple,t8015-pmp";
        reg = <0x2 0x32300000 0x0 0x8000>,
              <0x2 0x32400000 0x0 0x10000>,
              <0x2 0x32500000 0x0 0x20000>;
        reg-names = "akf", "control", "sram";
        mboxes = <&pmp_mbox>;
        mbox-names = "mbox";
        power-domains = <&ps_pmp>;
        firmware-name = "apple/pmp-t8015.bin";
      };
    };
```

## Documentation/devicetree/bindings/usb/apple,dwc3.yaml
```yaml
# SPDX-License-Identifier: (GPL-2.0-only OR BSD-2-Clause)
%YAML 1.2
---
$id: http://devicetree.org/schemas/usb/apple,dwc3.yaml#
$schema: http://devicetree.org/meta-schemas/core.yaml#

title: Apple Silicon DWC3 USB controller

maintainers:
  - Sven Peter <sven@svenpeter.dev>

description:
  Apple Silicon SoCs use a Synopsys DesignWare DWC3 based controller for each of
  their Type-C ports.

allOf:
  - $ref: snps,dwc3-common.yaml#

properties:
  compatible:
    items:
      - enum:
          - apple,t6000-dwc3
          - apple,t6020-dwc3
          - apple,t8103-dwc3
          - apple,t8112-dwc3
      - const: apple,dwc3

  reg:
    maxItems: 1

  interrupts:
    maxItems: 1

  iommus:
    maxItems: 2

  resets:
    maxItems: 1

  power-domains:
    maxItems: 1

unevaluatedProperties: false

required:
  - compatible
  - reg
  - interrupts
  - iommus
  - resets
  - power-domains

examples:
  - |
    #include <dt-bindings/interrupt-controller/apple-aic.h>
    #include <dt-bindings/interrupt-controller/irq.h>

    usb@82280000 {
      compatible = "apple,t8103-dwc3", "apple,dwc3";
      reg = <0x82280000 0x10000>;
      interrupts = <AIC_IRQ 777 IRQ_TYPE_LEVEL_HIGH>;

      dr_mode = "otg";
      usb-role-switch;
      role-switch-default-mode = "host";
    };
```

## drivers/phy/apple/Kconfig
```kconfig
# SPDX-License-Identifier: GPL-2.0 OR BSD-2-Clause
config PHY_APPLE_ATC
	tristate "Apple Type-C PHY"
	depends on (ARM64 && ARCH_APPLE) || (COMPILE_TEST && !GENERIC_ATOMIC64)
	select GENERIC_PHY
	select TYPEC
	select APPLE_TUNABLE
	help
	  Enable this to add support for the Apple Type-C PHY found in
	  Apple Silicon M-series SoCs. This PHY supports USB2,
	  USB3, USB4, Thunderbolt, and DisplayPort.

	  If M is selected the module will be called 'phy-apple-atc'.

config PHY_APPLE_AUSB
	tristate "Apple AUSB PHY"
	depends on (ARM64 && ARCH_APPLE) || (COMPILE_TEST && !GENERIC_ATOMIC64)
	select GENERIC_PHY
	select APPLE_USBCOMPLEX
	help
	  Enable this to add support for the Apple AUSB PHY found in
	  Apple Silicon A-series SoCs before Type-C PHY is introduced.
	  This driver supports USB2.

	  If M is selected the module will be called 'phy-apple-ausb'.
```

## fs/apfs/Kconfig
```kconfig
# SPDX-License-Identifier: GPL-2.0-only
config APFS_FS
	tristate "Apple file system support"
	select LIBCRC32C
	select ZLIB_INFLATE
	select NLS
	select BUFFER_HEAD
	select FS_IOMAP
	select LEGACY_DIRECT_IO
	help
	  If you say Y here, you will be able to mount APFS volumes which is
	  used since macOS 10.13 as well as iOS 10.3 and replaces Extended HFS.
	  Write access is experimental and may corrupt your container, so it
	  is only allowed with a non-standard option "readwrite".

	  To compile this file system support as a module, choose M here: the
	  module will be called apfs.
```
