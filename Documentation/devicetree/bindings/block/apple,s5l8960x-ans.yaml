## Documentation/devicetree/bindings/block/apple,s5l8960x-ans.yaml
```yaml
# SPDX-License-Identifier: GPL-2.0 OR BSD-2-Clause
%YAML 1.2
---
$id: http://devicetree.org/schemas/block/apple,s5l8960x-ans.yaml#
$schema: http://devicetree.org/meta-schemas/core.yaml#

title: Apple ANS1 storage controller

maintainers:
  - Nick Chan <towinchenmi@gmail.com>

properties:
  compatible:
    oneOf:
      - const: apple,s5l8960x-ans
      - items:
          - enum:
              - apple,t7000-ans
              - apple,t7001-ans
          - const: apple,s5l8960x-ans

  reg:
    maxItems: 1
    description: AKF co-processor control registers

  power-domains:
    maxItems: 1
    description: ANS1 CPU and mailbox power domain

  mboxes:
    maxItems: 1
    description: Mailbox of the ANS1 co-processor

  resets:
    maxItems: 1

  memory-region:
    maxItems: 1
    description: Region containing ANS1 firmware

  memory-region-names:
    const: firmware

required:
  - compatible
  - reg
  - power-domains
  - mboxes
  - resets

additionalProperties: false

examples:
  - |
    #include <dt-bindings/interrupt-controller/apple-aic.h>
    #include <dt-bindings/interrupt-controller/irq.h>

    block@8040000 {
      compatible = "apple,t7000-ans", "apple,s5l8960x-ans";
      reg = <0x8040000 0x40000>;
      mboxes = <&ans_mbox>;
      power-domains = <&ps_ans>;
      resets = <&ps_ans>;
    };
```

## Documentation/devicetree/bindings/hwmon/apple,smc-hwmon.yaml
```yaml
# SPDX-License-Identifier: (GPL-2.0-only OR BSD-2-Clause)
%YAML 1.2
---
$id: http://devicetree.org/schemas/hwmon/apple,smc-hwmon.yaml#
$schema: http://devicetree.org/meta-schemas/core.yaml#

title: Apple SMC Hardware Monitoring

description:
  Apple's System Management Controller (SMC) exposes a vast array of
  hardware monitoring sensors, including temperature probes, current and
  voltage sense, power meters, and fan speeds. It also provides endpoints
  to manually control the speed of each fan individually. Each Apple
  Silicon device exposes a different set of endpoints via SMC keys. This
  is true even when two machines share an SoC. The CPU core temperature
  sensor keys on an M1 Mac mini are different to those on an M1 MacBook
  Pro, for example.

maintainers:
  - James Calligeros <jcalligeros99@gmail.com>

properties:
  compatible:
    const: apple,smc-hwmon

  current:
    description: SMC current sense endpoints
    type: object
    additionalProperties: false
    patternProperties:
      "^current-[A-Za-z0-9]{4}":
        type: object
        additionalProperties: false
        required:
          - apple,key-id
        properties:
          apple,key-id:
            $ref: /schemas/types.yaml#/definitions/string
            pattern: "^[A-Za-z0-9]{4}"
            description: The SMC FourCC key of the desired current sensor.
              Should match the node's suffix, but doesn't have to.
          label:
            $ref: /schemas/types.yaml#/definitions/string
            description: Human-readable name for the sensor

  fan:
    description: SMC fan control endpoints. A fan is made up of five
      SMC keys - the fan's current speed, its minimum speed, its maximum
      speed, a writeable target speed, and a writeable mode. The SMC will
      automatically manage system fans unless a 1 is written to the fan's
      mode key.
    type: object
    additionalProperties: false
    patternProperties:
      "^fan-[A-Za-z0-9]{4}":
        type: object
        additionalProperties: false
        required:
          - apple,key-id
        properties:
          apple,key-id:
            $ref: /schemas/types.yaml#/definitions/string
            pattern: "^[A-Za-z0-9]{4}"
            description: The SMC FourCC key of the desired fan. This is the
              main key, which reports the fan's current speed. Sould match
              the node's suffix, but doesn't have to.
          apple,fan-minimum:
            $ref: /schemas/types.yaml#/definitions/string
            pattern: "^[A-Za-z0-9]{4}"
            description: The minimum speed the current fan can run at
          apple,fan-maximum:
            $ref: /schemas/types.yaml#/definitions/string
            pattern: "^[A-Za-z0-9]{4}"
            description: The maximum speed the current fan can run at
          apple,fan-target:
            $ref: /schemas/types.yaml#/definitions/string
            pattern: "^[A-Za-z0-9]{4}"
            description: Writeable endpoint for setting desired fan speed
          apple,fan-mode:
            $ref: /schemas/types.yaml#/definitions/string
            pattern: "^[A-Za-z0-9]{4}"
            description: Writeable endpoint to enable/disable manual fan
              control
          label:
            $ref: /schemas/types.yaml#/definitions/string
            description: Human-readable name for the sensor

  power:
    description: SMC power meter endpoints
    type: object
    additionalProperties: false
    patternProperties:
      "^power-[A-Za-z0-9]{4}":
        type: object
        additionalProperties: false
        required:
          - apple,key-id
        properties:
          apple,key-id:
            $ref: /schemas/types.yaml#/definitions/string
            pattern: "^[A-Za-z0-9]{4}"
            description: The SMC FourCC key of the desired power meter.
              Should match the node's suffix, but doesn't have to.
          label:
            $ref: /schemas/types.yaml#/definitions/string
            description: Human-readable name for the sensor

  temperature:
    description: SMC temperature sensor endpoints
    type: object
    additionalProperties: false
    patternProperties:
      "^temperature-[A-Za-z0-9]{4}":
        type: object
        additionalProperties: false
        required:
          - apple,key-id
        properties:
          apple,key-id:
            $ref: /schemas/types.yaml#/definitions/string
            pattern: "^[A-Za-z0-9]{4}"
            description: The SMC FourCC key of the desired temperature
              sensor. Should match the node's suffix, but doesn't have to.
          label:
            $ref: /schemas/types.yaml#/definitions/string
            description: Human-readable name for the sensor

  voltage:
    description: SMC voltage sensor endpoints
    type: object
    additionalProperties: false
    patternProperties:
      "^voltage-[A-Za-z0-9]{4}":
        type: object
        additionalProperties: false
        required:
          - apple,key-id
        properties:
          apple,key-id:
            $ref: /schemas/types.yaml#/definitions/string
            pattern: "^[A-Za-z0-9]{4}"
            description: The SMC FourCC key of the desired voltage
              sensor. Should match the node's suffix, but doesn't have to.
          label:
            $ref: /schemas/types.yaml#/definitions/string
            description: Human-readable name for the sensor

additionalProperties: false
```

## Documentation/devicetree/bindings/leds/backlight/dlg,da2xxx-bl.yaml
```yaml
# SPDX-License-Identifier: (GPL-2.0 OR BSD-2-Clause)
%YAML 1.2
---
$id: http://devicetree.org/schemas/leds/backlight/dlg,da2xxx-bl.yaml#
$schema: http://devicetree.org/meta-schemas/core.yaml#

title: Dialog DA2089/DA2207/DA2257/DA2400 PMIC backlight

maintainers:
  - Nick Chan <towinchenmi@gmail.com>

description:
  This module is part of Dialog DA2xxx PMICs. For more details see
  ../mfd/dlg,da2xxx.yaml.

  A backlight interface in Dialog PMICs. There are two variants
  differing in how the backlight value is encoded in the registers.

allOf:
  - $ref: common.yaml#

properties:
  compatible:
    oneOf:
      - items:
          - const: dlg,da2207-bl
          - const: dlg,da2089-bl
      - items:
          - const: dlg,da2400-bl
          - const: dlg,da2257-bl
      - const: dlg,da2089-bl
      - const: dlg,da2257-bl

  reg:
    maxItems: 1

required:
  - compatible
  - reg

additionalProperties: false
```

## Documentation/devicetree/bindings/mfd/dlg,da2xxx.yaml
```yaml
---
$id: http://devicetree.org/schemas/mfd/dlg,da2xxx.yaml#
$schema: http://devicetree.org/meta-schemas/core.yaml#

title: Dialog DA2XXX PMICs

maintainers:
  - Nick Chan <towinchenmi@gmail.com>

description: |
  Apple SoCs came with PMICs designed by Dialog Semiconductor before
  Apple switched to their own PMIC designs. On A7 - A10X SoCs, they
  are attached over I2C. On A11 and T2 the PMIC is attached via SPMI
  instead. The parts used by Apple appears to be quite different
  from public parts offered by Dialog. This binding describes simple
  MFD - I2C/SPMI device with 16-bit register address and 8-bit values
  that allows subdevices like RTC, power-off control and backlight to
  be described.

properties:
  compatible:
    oneOf:
      - items:
          - enum:
              - dlg,da2045
              - dlg,da2089
              - dlg,da2186
              - dlg,da2207
              - dlg,da2255
              - dlg,da2257
              - dlg,da2333
              - dlg,da2365
              - dlg,da2400
              - dlg,da2401
          - const: dlg,i2c-da2xxx
      - items:
          - enum:
              - dlg,da2422
              - dlg,da2449
          - const: dlg,spmi-da2xxx

  reg:
    maxItems: 1

  "#address-cells":
    const: 1

  "#size-cells":
    const: 1

patternProperties:
  "^backlight(@[0-9a-f]+)?$":
    $ref: /schemas/leds/backlight/dlg,da2xxx-bl.yaml

  "^rtc(@[0-9a-f]+)?$":
    $ref: /schemas/rtc/dlg,da2xxx-rtc.yaml

  "^nvmem(@[0-9a-f]+)?$":
    $ref: /schemas/nvmem/dlg,da2xxx-nvmem.yaml

required:
  - compatible
  - reg
  - "#address-cells"
  - "#size-cells"

additionalProperties: false

examples:
  - |
    i2c {
        #address-cells = <1>;
        #size-cells = <0>;

        pmic@3c {
            compatible = "dlg,da2207", "dlg,i2c-da2xxx";
            reg = <0x3c>;
            #address-cells = <1>;
            #size-cells = <1>;

            rtc@500 {
                compatible = "dlg,da2207-rtc", "dlg,da2045-rtc";
                reg = <0x500 0x10>;
                nvmem-cells = <&rtc_offset_0>;
                nvmem-cell-names = "rtc_offset";
            };

            backlight@600 {
                compatible = "dlg,da2207-bl", "dlg,da2089-bl";
                reg = <0x600 0x2>;
            };

            nvmem@4000 {
                compatible = "dlg,da2xxx-nvmem";
                reg = <0x4000 0x28>;

                nvmem-layout {
                    compatible = "fixed-layout";
                    #address-cells = <1>;
                    #size-cells = <1>;

                    rtc_offset_0: rtc-offset@4 {
                        reg = <0x4 0x4>;
                    };
                };
            };
        };
    };

  - |

    #include <dt-bindings/spmi/spmi.h>

    spmi {
        #address-cells = <2>;
        #size-cells = <0>;

        pmic@f {
            compatible = "dlg,da2422", "dlg,spmi-da2xxx";
            reg = <0xf SPMI_USID>;
            #address-cells = <1>;
            #size-cells = <1>;

            rtc@1400 {
                compatible = "dlg,da2422-rtc", "dlg,da2255-rtc";
                reg = <0x1400 0x10>;
                nvmem-cells = <&rtc_offset_1>;
                nvmem-cell-names = "rtc_offset";
            };

            nvmem@6000 {
                compatible = "dlg,da2xxx-nvmem";
                reg = <0x6000 0x300>;

                nvmem-layout {
                    compatible = "fixed-layout";
                    #address-cells = <1>;
                    #size-cells = <1>;

                    rtc_offset_1: rtc-offset@4 {
                        reg = <0x4 0x4>;
                    };
                };
            };
        };
    };
```

## Documentation/devicetree/bindings/mfd/dlg,i2c-da2xxx.yaml
```yaml
# SPDX-License-Identifier: (GPL-2.0 OR BSD-2-Clause)
%YAML 1.2
---
$id: http://devicetree.org/schemas/mfd/dlg,i2c-da2xxx.yaml#
$schema: http://devicetree.org/meta-schemas/core.yaml#

title: Dialog DA2XXX PMICs over I2C in Apple Products

maintainers:
  - Nick Chan <towinchenmi@gmail.com>

description: |
  Apple SoCs came with PMICs designed by Dialog Semiconductor before
  Apple switched to their own PMIC designs. On A7 - A10X SoCs, they
  are attached over I2C. The parts used by Apple appears to be quite
  different from public parts offered by Dialog. This binding
  describes a simple MFD - I2C device with 16-bit register address
  and 8-bit values that allows subdevices like RTC, power-off control
  and backlight to be described.

properties:
  compatible:
    items:
      - enum:
          - dlg,da2045
          - dlg,da2089
          - dlg,da2186
          - dlg,da2207
          - dlg,da2255
          - dlg,da2257
          - dlg,da2333
          - dlg,da2365
          - dlg,da2400
          - dlg,da2401
      - const: dlg,i2c-da2xxx

  reg:
    maxItems: 1

  '#address-cells':
    const: 1

  '#size-cells':
    const: 0

patternProperties:
  "^backlight(@[0-9a-f]+)?$":
    $ref: /schemas/leds/backlight/dlg,da2xxx-bl.yaml

required:
  - compatible
  - reg
  - "#address-cells"
  - "#size-cells"

additionalProperties: false

examples:
  - |
    i2c {
      #address-cells = <1>;
      #size-cells = <0>;

      pmu@3c {
        compatible = "dlg,da2207", "dlg,i2c-da2xxx";
        reg = <0x3c>;
        #address-cells = <1>;
        #size-cells = <0>;

        backlight@600 {
          compatible = "dlg,da2207-bl", "dlg,da2089-bl";
          reg = <0x600>;
        };
      };
    };
```

## Documentation/devicetree/bindings/nvmem/dlg,da2xxx-nvmem.yaml
```yaml
# SPDX-License-Identifier: GPL-2.0-only OR BSD-2-Clause
%YAML 1.2
---
$id: http://devicetree.org/schemas/nvmem/dlg,da2xxx-nvmem.yaml#
$schema: http://devicetree.org/meta-schemas/core.yaml#

title: Dialog DA2XXX PMIC NVMEM

description: |
  This module is part of Dialog DA2XXX PMICs. For more details see
  ../mfd/dlg,da2xxx.yaml.

  NVMEM cells found in Dialog DA2xxx PMICs are used to store
  information including RTC offset and boot failure count.

maintainers:
  - Nick Chan <towinchenmi@gmail.com>

allOf:
  - $ref: nvmem.yaml#

properties:
  compatible:
    const: dlg,da2xxx-nvmem

  reg:
    maxItems: 1

required:
  - compatible
  - reg

unevaluatedProperties: false
...
```
